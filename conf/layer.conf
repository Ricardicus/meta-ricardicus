## conf/layer.conf
```bitbake
# We have a conf and classes directory, add to BBPATH
BBPATH .= ":${LAYERDIR}"

# We have recipes-* directories, add to BBFILES
BBFILES += "${LAYERDIR}/recipes-*/*/*.bb \
            ${LAYERDIR}/recipes-*/*/*.bbappend"

BBFILE_COLLECTIONS += "meta-ricardicus"
BBFILE_PATTERN_meta-ricardicus = "^${LAYERDIR}/"
BBFILE_PRIORITY_meta-ricardicus = "6"

LAYERDEPENDS_meta-ricardicus = "core"
LAYERSERIES_COMPAT_meta-ricardicus = "thud"
```

## conf/machine/our-raspbian.conf
```bitbake
DEFAULTTUNE ?= "cortexa7thf-neon-vfpv4"
require conf/machine/include/tune-cortexa7.inc

MACHINE_FEATURES += "pci"
```
